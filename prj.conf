## CMakeLists.txt
```
cmake_minimum_required(VERSION 3.20.0)
find_package(Zephyr REQUIRED HINTS $ENV{ZEPHYR_BASE})

project(my_adc_app)

# Source dosyaları
target_sources(app PRIVATE
    main.c
    app_drivers/adc.c
    app_tasks/app_tasks.c
    app_lib/shell.c
    app_lib/ble_dfu.c
)

# Header dosyalarının yolu
target_include_directories(app PRIVATE
    app_drivers
    app_tasks
    app_lib
)
```

## sysbuild.conf
```
SB_CONFIG_BOOTLOADER_MCUBOOT=y
SB_CONFIG_BOOT_SIGNATURE_TYPE_ECDSA_P256=y
SB_CONFIG_BOOT_SIGNATURE_KEY_FILE="${APP_DIR}/keys/mcuboot-ec256.pem"
```

## prj.conf
```kconfig
CONFIG_ADC=y
CONFIG_SERIAL=y
CONFIG_CONSOLE=y
CONFIG_PRINTK=y

# Shell
CONFIG_SHELL=y
CONFIG_SHELL_BACKENDS=y
CONFIG_SHELL_BACKEND_SERIAL=y
CONFIG_SHELL_PROMPT_UART="gsr> "
CONFIG_SHELL_HISTORY=y
CONFIG_SHELL_HISTORY_BUFFER=512

# Reboot
CONFIG_REBOOT=y

# ---- MCUboot (bootloader awareness) ----
CONFIG_BOOTLOADER_MCUBOOT=y
CONFIG_MCUBOOT_IMG_MANAGER=y
CONFIG_MCUBOOT_GENERATE_CONFIRMED_IMAGE=y

# ---- Flash ----
CONFIG_FLASH=y
CONFIG_FLASH_MAP=y
CONFIG_FLASH_PAGE_LAYOUT=y
CONFIG_STREAM_FLASH=y
CONFIG_IMG_MANAGER=y
CONFIG_IMG_ERASE_PROGRESSIVELY=y

# ---- BLE ----
CONFIG_BT=y
CONFIG_BT_PERIPHERAL=y
CONFIG_BT_DEVICE_NAME="GSR-Device"
CONFIG_BT_DEVICE_APPEARANCE=0
CONFIG_BT_MAX_CONN=1
CONFIG_BT_L2CAP_TX_BUF_COUNT=6

# BLE MTU for SMP/DFU
CONFIG_BT_L2CAP_TX_MTU=252
CONFIG_BT_BUF_ACL_RX_SIZE=256
CONFIG_BT_BUF_ACL_TX_SIZE=256
CONFIG_BT_CTLR_DATA_LENGTH_MAX=251

# ---- MCUmgr (SMP over BLE) ----
CONFIG_MCUMGR=y
CONFIG_MCUMGR_TRANSPORT_BT=y
CONFIG_MCUMGR_GRP_IMG=y
CONFIG_MCUMGR_GRP_OS=y
CONFIG_MCUMGR_GRP_OS_BOOTLOADER_INFO=y

# MCUmgr buffers
CONFIG_MCUMGR_TRANSPORT_NETBUF_SIZE=2475
CONFIG_MCUMGR_TRANSPORT_NETBUF_COUNT=4
CONFIG_MCUMGR_TRANSPORT_BT_REASSEMBLY=y

# Dependencies
CONFIG_NET_BUF=y
CONFIG_ZCBOR=y

# Workqueue
CONFIG_SYSTEM_WORKQUEUE_STACK_SIZE=2304
```

## boards/nrf52840dk_nrf52840.overlay
```dts
/ {
	zephyr,user {
		io-channels = <&adc 0>;
	};
};

&adc {
	status = "okay";
	#address-cells = <1>;
	#size-cells = <0>;

	channel@0 {
		reg = <0>;
		zephyr,gain = "ADC_GAIN_1";
		zephyr,reference = "ADC_REF_INTERNAL";
		zephyr,acquisition-time = <ADC_ACQ_TIME_DEFAULT>;
		zephyr,input-positive = <NRF_SAADC_AIN0>; /* P0.02 */
		zephyr,resolution 
        = <12>;
		zephyr,oversampling = <4>;
	};
};
```

## boards/nrf54l15dk_nrf54l15_cpuapp.overlay
```dts
/ {
	zephyr,user {
		io-channels = <&adc 0>;
	};
};

&adc {
	status = "okay";
	#address-cells = <1>;
	#size-cells = <0>;

	channel@0 {
		reg = <0>;
		zephyr,gain = "ADC_GAIN_1";
		zephyr,reference = "ADC_REF_INTERNAL";
		zephyr,acquisition-time = <ADC_ACQ_TIME_DEFAULT>;
		zephyr,input-positive = <NRF_SAADC_AIN4>; /* P1.11 */
		zephyr,resolution = <12>;
		zephyr,oversampling = <4>;
	};
};
```

## src/main.c
```c
#include <zephyr/kernel.h>
#include <zephyr/sys/printk.h>

#include "adc.h"

int main(void)
{
	int err;

	printk("ADC periodic sampling start\n");

	err = adc_init();
	if (err) {
		printk("ADC init failed: %d\n", err);
		return 0;
	}

	adc_start_periodic_sampling();

	while (1) {
		k_sleep(K_FOREVER);
	}

	return 0;
}
```

## inc/app_tasks.h
```c
#ifndef APP_TASKS_H
#define APP_TASKS_H

#include <zephyr/kernel.h>

/* Heart beat task */
void heart_beat_task_start(void);

#endif /* APP_TASKS_H */
```
